## config/west.yml
```yaml
manifest:
  remotes:
    - name: zmkfirmware
      url-base: https://github.com/Samdasoo1076
  projects:
    - name: zmkfirmwares
      remote: zmkfirmware
      revision: example
      import: config/west.yml
  self:
    path: config
```

## zephyr/config/west.yml
```yaml
manifest:

remotes:
  - name: zmkfirmware
url-base: https://github.com/Samdasoo1076
projects:
  - name: zmkfirmware
remote: zmkfirmware
revision: main
import: config/west.yml
self:
path: config
```
